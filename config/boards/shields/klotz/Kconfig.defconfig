## config/boards/shields/klotz/Kconfig.defconfig
```kconfig
if SHIELD_KLOTZ_DONGLE

    config ZMK_KEYBOARD_NAME
        default "KLOTZ"

    config ZMK_SPLIT_ROLE_CENTRAL
        default y

    config ZMK_SPLIT_BLE_CENTRAL_PERIPHERALS
        default 2

endif # DONGLE



if SHIELD_KLOTZ_DONGLE || SHIELD_KLOTZ_LEFT || SHIELD_KLOTZ_RIGHT

    config ZMK_SPLIT
        default y

endif # DONGLE LEFT RIGHT


if ZMK_BACKLIGHT

    config PWM
        default y

    config LED_PWM
        default y

endif # ZMK_BACKLIGHT
```
