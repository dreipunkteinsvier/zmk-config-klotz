#include "klotz.dtsi"

/ {
   chosen {
      zmk,kscan = &mock_kscan;
   };

   mock_kscan: kscan_1 {
      compatible = "zmk,kscan-mock";
      columns = <0>;
      rows = <0>;
      events = <0>;
   };
};

// only required if the dongle uses a
// different board than the peripherals

/delete-node/ &kscan0;
/delete-node/ &left_encoder;
/delete-node/ &right_encoder;
